#pragma GCC optimize ("O2")

#include "shared.h"


/* VDP context */
t_vdp vdp;


/* Return values from the V counter */
const uint8 vcnt[0x200] =
{
    0x00, 0x01, 0x02, 0x03, 0x04, 0x05, 0x06, 0x07, 0x08, 0x09, 0x0A, 0x0B, 0x0C, 0x0D, 0x0E, 0x0F,
    0x10, 0x11, 0x12, 0x13, 0x14, 0x15, 0x16, 0x17, 0x18, 0x19, 0x1A, 0x1B, 0x1C, 0x1D, 0x1E, 0x1F,
    0x20, 0x21, 0x22, 0x23, 0x24, 0x25, 0x26, 0x27, 0x28, 0x29, 0x2A, 0x2B, 0x2C, 0x2D, 0x2E, 0x2F,
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    0xF0, 0xF1, 0xF2, 0xF3, 0xF4, 0xF5, 0xF6, 0xF7, 0xF8, 0xF9, 0xFA, 0xFB, 0xFC, 0xFD, 0xFE, 0xFF,
};

/* Return values from the H counter */
const uint8 hcnt[0x200] =
{
    0x00, 0x01, 0x02, 0x03, 0x04, 0x05, 0x06, 0x07, 0x08, 0x09, 0x0A, 0x0B, 0x0C, 0x0D, 0x0E, 0x0F,
    0x10, 0x11, 0x12, 0x13, 0x14, 0x15, 0x16, 0x17, 0x18, 0x19, 0x1A, 0x1B, 0x1C, 0x1D, 0x1E, 0x1F,
    0x20, 0x21, 0x22, 0x23, 0x24, 0x25, 0x26, 0x27, 0x28, 0x29, 0x2A, 0x2B, 0x2C, 0x2D, 0x2E, 0x2F,
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    0xF0, 0xF1, 0xF2, 0xF3, 0xF4, 0xF5, 0xF6, 0xF7, 0xF8, 0xF9, 0xFA, 0xFB, 0xFC, 0xFD, 0xFE, 0xFF,
};


/*--------------------------------------------------------------------------*/


/* Initialize VDP emulation */
void vdp_init(void)
{
    vdp_reset();
}


/* Reset VDP emulation */
void vdp_reset(void)
{
    memset(&vdp, 0, sizeof(t_vdp));
    vdp.limit = 1;
}


/* Write data to the VDP's control port */
void vdp_ctrl_w(int data)
{
    /* Waiting for the reset of the command? */
    if(vdp.pending == 0)
    {
        /* Save data for later */
        vdp.latch = data;

        /* Set pending flag */
        vdp.pending = 1;
    }
    else
    {
        /* Clear pending flag */
        vdp.pending = 0;

        /* Extract code bits */
        vdp.code = (data >> 6) & 3;

        /* Make address */
        vdp.addr = (data << 8 | vdp.latch) & 0x3FFF;

        /* Read VRAM for code 0 */
        if(vdp.code == 0)
        {
            /* Load buffer with current VRAM byte */
            vdp.buffer = vdp.vram[vdp.addr & 0x3FFF];

            /* Bump address */
            vdp.addr += 1;
        }

        /* VDP register write */
        if(vdp.code == 2)
        {
            int r = (data & 0x0F);
            int d = vdp.latch;

            /* Store register data */
            vdp.reg[r] = d;

            /* Update table addresses */
            vdp.ntab = (vdp.reg[2] << 10) & 0x3800;
            vdp.satb = (vdp.reg[5] << 7) & 0x3F00;
        }
    }
}


/* Read the status flags */
int vdp_ctrl_r(void)
{
    /* Save the status flags */
    uint8 temp = vdp.status;

    /* Clear pending flag */
    vdp.pending = 0;

    /* Clear pending interrupt and sprite collision flags */
    vdp.status &= ~(0x80 | 0x40 | 0x20);

    /* Lower the IRQ line */
    if(sms.irq == 1)
    {
        sms.irq = 0;
        z80_set_irq_line(0, CLEAR_LINE);
    }

    /* Return the old status flags */
    return (temp);
}


/* Write data to the VDP's data port */
void vdp_data_w(int data)
{
    int index;

    /* Clear the pending flag */
    vdp.pending = 0;

    switch(vdp.code)
    {
        case 0: /* VRAM write */
        case 1: /* VRAM write */
        case 2: /* VRAM write */

            /* Get current address in VRAM */
            index = (vdp.addr & 0x3FFF);

            /* Only update if data is new */
            if(data != vdp.vram[index])
            {
                /* Store VRAM byte */
                vdp.vram[index] = data;

                /* Mark patterns as dirty */
				vramMarkTileDirty((index >> 5));
            }
            break;

        case 3: /* CRAM write */
            if(cart.type == TYPE_GG)
            {
                index = (vdp.addr & 0x3F);
                if(data != vdp.cram[index])
                {
                    vdp.cram[index] = data;
                    index = (vdp.addr >> 1) & 0x1F;
                    palette_sync(index);
                }
            }
            else
            {
                index = (vdp.addr & 0x1F);
                if(data != vdp.cram[index])
                {
                    vdp.cram[index] = data;
                    palette_sync(index);
                }
            }
            break;
    }

    /* Bump the VRAM address */
    vdp.addr = (vdp.addr + 1) & 0x3FFF;
}


/* Read data from the VDP's data port */
int vdp_data_r(void)
{
    uint8 temp = 0;
    vdp.pending = 0;
    temp = vdp.buffer;
    vdp.buffer = vdp.vram[vdp.addr & 0x3FFF];
    vdp.addr = (vdp.addr + 1) & 0x3FFF;
    return temp;
}


/* Process frame events */
void vdp_run(void)
{
    if(vdp.line <= 0xC0)
    {
        if(vdp.line == 0xC0)
        {
            vdp.status |= 0x80;
        }

        if(vdp.line == 0)
        {
            vdp.left = vdp.reg[10];
        }

        if(vdp.left == 0)
        {
            vdp.left = vdp.reg[10];
            vdp.status |= 0x40;
        }
        else
        {
            vdp.left -= 1;
        }

        if((vdp.status & 0x40) && (vdp.reg[0] & 0x10))
        {
            sms.irq = 1;
            z80_set_irq_line(0, ASSERT_LINE);
        }
    }
    else
    {
        vdp.left = vdp.reg[10];

        if((vdp.line < 0xE0) && (vdp.status & 0x80) && (vdp.reg[1] & 0x20))
        {
            sms.irq = 1;
            z80_set_irq_line(0, ASSERT_LINE);
        }
    }
}


uint8 vdp_vcounter_r(void)
{
    return (vcnt[(vdp.line & 0x1FF)]);
}


uint8 vdp_hcounter_r(void)
{
    int pixel = (((z80_ICount % CYCLES_PER_LINE) / 4) * 3) * 2;
    return (hcnt[((pixel >> 1) & 0x1FF)]);
}
